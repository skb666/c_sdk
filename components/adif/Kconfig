## components/adif/Kconfig
```kconfig
config ADIF_ENABLED
    bool "enable adif"
    help
        常用数据结构和算法基础库
    default n
```

## components/cjson/Kconfig
```kconfig
config CJSON_ENABLED
    bool "enable cjson"
    help
        ANSI-C 标准的 JSON 解析器
    default n

config CJSON_UTILS_SUPPORT
    depends on CJSON_ENABLED
    bool "support cjson_utils"
    help
        开启以支持 JSON 解析器拓展语法
    default n
```

## components/curl/Kconfig
```kconfig
config CURL_ENABLED
    bool "enable curl"
    help
        通过 vcpkg 安装的 libcurl
    default n
```

## components/ejet/Kconfig
```kconfig
config EJET_ENABLED
    bool "enable ejet"
    help
        事件驱动模型、多线程、大并发连接的轻量级的高性能Web服务器，支持HTTP/1.0和HTTP/1.1协议，并支持HTTP Proxy、Tunnel等功能
    default n
    select ADIF_ENABLED
    select EPUMP_ENABLED
```

## components/epump/Kconfig
```kconfig
config EPUMP_ENABLED
    bool "enable epump"
    help
        基于I/O事件通知、非阻塞通信、多路复用、多线程等机制开发的事件驱动模型应用开发框架
    default n
    select ADIF_ENABLED
```
